## CMakeLists.txt
```
# SPDX-License-Identifier: Apache-2.0
# 配套 zhaoming-embedded 在线书 ch19 + 附录 B
# 用法 (在本目录下)：
#   west build -b stm32f4_disco -p auto -- -DDEMO=1
#   west build -b stm32f4_disco -p auto -- -DDEMO=2
#   west build -b stm32f4_disco -p auto -- -DDEMO=3
#   west build -b stm32f4_disco -p auto -- -DDEMO=4

cmake_minimum_required(VERSION 3.20.0)

find_package(Zephyr REQUIRED HINTS $ENV{ZEPHYR_BASE})
project(industrial_zephyr)

# 默认跑 demo1 (4 LED 同 ops 表)
if(NOT DEFINED DEMO)
    set(DEMO 1)
endif()

# 显式 if/elseif 把 DEMO 编号映射到 .c 文件·避免 wildcard 把多个文件同时编进去
if(DEMO EQUAL 1)
    target_sources(app PRIVATE src/main_demo1_4led.c)
    message(STATUS "[industrial-zephyr] DEMO=1 4 LED 同 ops 表 (ch19/19.7 向上转型)")
elseif(DEMO EQUAL 2)
    target_sources(app PRIVATE src/main_demo2_overlay.c)
    message(STATUS "[industrial-zephyr] DEMO=2 overlay 改 label (ch19/19.8 dts 解耦)")
elseif(DEMO EQUAL 3)
    target_sources(app PRIVATE src/main_demo3_container.c)
    message(STATUS "[industrial-zephyr] DEMO=3 CONTAINER_OF 抓回调 (ch19/19.9)")
elseif(DEMO EQUAL 4)
    target_sources(app PRIVATE src/main_demo4_enosys.c)
    message(STATUS "[industrial-zephyr] DEMO=4 可空 ops 看 -ENOSYS (ch19/19.10)")
else()
    message(FATAL_ERROR "DEMO 只能是 1/2/3/4·当前 DEMO=${DEMO}")
endif()
```

## prj.conf
```kconfig
# SPDX-License-Identifier: Apache-2.0
# 配套 zhaoming-embedded ch19 + 附录 B
# 4 个 demo 公用一份 prj.conf·按需开关由源码 #include 决定

# LED subsystem (ch19/19.7 用·演示同 ops 表跑多个 LED)
CONFIG_LED=y
CONFIG_LED_GPIO=y

# GPIO (demo2 / demo3 都用到)
CONFIG_GPIO=y

# 日志 + 串口 printk (demo2 看 label / demo3 看 offset / demo4 看 -ENOSYS 返回值)
CONFIG_LOG=y
CONFIG_PRINTK=y
CONFIG_SERIAL=y
CONFIG_UART_CONSOLE=y

# 调小栈避免链接告警·stm32f4_disco SRAM 192KB 够用
CONFIG_MAIN_STACK_SIZE=2048
```

## boards/stm32f4_disco.overlay
```dts
/* SPDX-License-Identifier: Apache-2.0
 *
 * Demo 2 用·只改 led0 的 label
 * 验证 overlay 生效·应用层零改动·重新 build 后 printk 输出新 label
 *
 * 配套 ch19/19.8 dts 解耦
 * stm32f4_disco 的 4 颗用户 LED 在 zephyr/boards/st/stm32f4_disco/stm32f4_disco.dts
 * 节点名 green_led_4 (LD4) / orange_led_3 (LD3) / red_led_5 (LD5) / blue_led_6 (LD6)
 */

&green_led_4 {
    label = "Demo Board LD4 (overlay)";
};
```

## src/main_demo1_4led.c
```c
/* SPDX-License-Identifier: Apache-2.0
 *
 * Demo 1: 4 颗 LED 同 ops 表跑 (ch19/19.7 向上转型)
 *
 * 教学要点：
 *   - 4 颗 LED 共用一个 led_classdev / leds 节点
 *   - led_on / led_off 第一参数都是 const struct device *
 *   - 子类在 dts 里 (gpios = <...>)·应用层只见父类 ops
 *   - 这就是经典向上转型：应用层拿到 base 指针·不知道也不关心子类是 GPIO LED 还是 PWM LED
 */

#include <zephyr/kernel.h>
#include <zephyr/drivers/led.h>
#include <zephyr/sys/printk.h>

#define LED_NODE DT_NODELABEL(leds)

int main(void)
{
    const struct device *led_dev = DEVICE_DT_GET(LED_NODE);

    if (!device_is_ready(led_dev)) {
        printk("LED device not ready\n");
        return -1;
    }

    printk("[demo1] 4 LED 同 ops 表跑·按编号 0/1/2/3 顺次点亮\n");

    while (1) {
        for (int i = 0; i < 4; i++) {
            led_on(led_dev, i);
            k_msleep(200);
            led_off(led_dev, i);
        }
    }

    return 0;
}
```

## src/main_demo2_overlay.c
```c
/* SPDX-License-Identifier: Apache-2.0
 *
 * Demo 2: overlay 改 label·应用层零改动 (ch19/19.8 dts 解耦)
 *
 * 教学要点：
 *   - boards/stm32f4_disco.overlay 改了 green_led_4 的 label
 *   - 这里通过 DT_PROP 在编译期取出 label 字符串·printk 出来证明 overlay 生效
 *   - 没动 .c 任何一行·只是 build 系统把 overlay 合进了 zephyr.dts
 *   - 这就是 dts 解耦的威力：硬件描述外移·应用层稳如老狗
 *
 * 期望输出：
 *   led0 label: Demo Board LD4 (overlay)
 *   (如果不带 overlay 重新 build·会打印 dts 默认的 label·两次对比说明 overlay 生效)
 */

#include <zephyr/kernel.h>
#include <zephyr/drivers/led.h>
#include <zephyr/sys/printk.h>

#define LED_NODE DT_NODELABEL(leds)

/* led0 alias 在 stm32f4_disco.dts 里指向 green_led_4 */
#define LED0_NODE DT_ALIAS(led0)

int main(void)
{
    const struct device *led_dev = DEVICE_DT_GET(LED_NODE);

    if (!device_is_ready(led_dev)) {
        printk("LED device not ready\n");
        return -1;
    }

    /* 关键一行：从 dts 拿 label·overlay 改了就这里变 */
    printk("[demo2] led0 label: %s\n", DT_PROP(LED0_NODE, label));
    printk("[demo2] 应用层一行没改·只是 boards/stm32f4_disco.overlay 改了 label\n");

    /* 和 demo1 一样跑 4 LED·证明业务逻辑稳定 */
    while (1) {
        for (int i = 0; i < 4; i++) {
            led_on(led_dev, i);
            k_msleep(200);
            led_off(led_dev, i);
        }
    }

    return 0;
}
```

## src/main_demo3_container.c
```c
/* SPDX-License-Identifier: Apache-2.0
 *
 * Demo 3: CONTAINER_OF 抓回调
 *
 * 教学要点：
 *   - Zephyr 的回调签名固定·只给一个基础类型指针 (k_timer * / gpio_callback *)
 *   - 要拿到自定义上下文·必须 CONTAINER_OF 反推
 *   - ch13 讲过的"从字段指针反推容器指针"·offsetof 算偏移再减
 *
 * stm32f4_disco 板载没合适用户按钮·这里改用定时器周期回调
 * 演示原理一样：回调函数只拿到 k_timer*·靠 CONTAINER_OF 反推到 app_timer_ctx
 *
 * gdb 验证：
 *   p &ctx              // 自定义结构起始地址
 *   p &ctx.timer        // timer 字段地址
 *   p &ctx.timer - &ctx // 应该等于 offsetof(app_timer_ctx, timer)
 */

#include <zephyr/kernel.h>
#include <zephyr/drivers/led.h>
#include <zephyr/sys/printk.h>
#include <stddef.h>

#define LED_NODE DT_NODELABEL(leds)

/* 自定义上下文·timer 是父类·业务字段 led_dev / tick_count 是派生扩展 */
struct app_timer_ctx {
    struct k_timer        timer;     /* 父类·必须放在能被 CONTAINER_OF 反推的位置 */
    const struct device  *led_dev;
    uint32_t              tick_count;
    uint8_t               which_led;
};

static void on_timer_expired(struct k_timer *t)
{
    /* 关键一行：从 t 反推回 ctx·拿到自定义上下文 */
    struct app_timer_ctx *ctx =
        CONTAINER_OF(t, struct app_timer_ctx, timer);

    ctx->tick_count++;

    /* 偶数 tick 点亮·奇数 tick 熄灭·演示拿到上下文之后做业务 */
    if (ctx->tick_count & 1U) {
        led_on(ctx->led_dev, ctx->which_led);
    } else {
        led_off(ctx->led_dev, ctx->which_led);
    }

    if (ctx->tick_count <= 6) {
        printk("[demo3] tick=%u led=%u  ctx=%p timer=%p offset=%u\n",
               ctx->tick_count, ctx->which_led,
               (void *)ctx, (void *)t,
               (unsigned)offsetof(struct app_timer_ctx, timer));
    }
}

static struct app_timer_ctx g_ctx;

int main(void)
{
    g_ctx.led_dev    = DEVICE_DT_GET(LED_NODE);
    g_ctx.tick_count = 0;
    g_ctx.which_led  = 0;

    if (!device_is_ready(g_ctx.led_dev)) {
        printk("LED device not ready\n");
        return -1;
    }

    printk("[demo3] CONTAINER_OF 抓回调演示开始\n");
    printk("[demo3] offsetof(ctx, timer) = %u\n",
           (unsigned)offsetof(struct app_timer_ctx, timer));

    k_timer_init(&g_ctx.timer, on_timer_expired, NULL);
    k_timer_start(&g_ctx.timer, K_MSEC(300), K_MSEC(300));

    /* main 退出·timer 在系统线程里继续跑 */
    return 0;
}
```

## src/main_demo4_enosys.c
```c
/* SPDX-License-Identifier: Apache-2.0
 *
 * Demo 4: 可空 ops 演示·调 led_blink 看 -ENOSYS (ch19/19.10)
 *
 * 教学要点：
 *   - led_driver_api 的 ops 表里 blink 是可空字段
 *   - led_gpio 子类只实现了 set_brightness·blink 留 NULL
 *   - led 子系统检测到 NULL·直接返回 -ENOSYS (errno 88)
 *   - 这就是 ch16 讲的"NULL 检查 + ENOSYS"模式：父类不强迫子类实现所有动作
 *
 * 期望输出：
 *   led_blink returned -88           // -ENOSYS
 *   led_set_brightness returned 0    // 正常
 *
 * 对比 C++ pure virtual：那种是编译期强制·这种是运行期可选·内核风味更宽容
 */

#include <zephyr/kernel.h>
#include <zephyr/drivers/led.h>
#include <zephyr/sys/printk.h>
#include <errno.h>

#define LED_NODE DT_NODELABEL(leds)

int main(void)
{
    const struct device *led_dev = DEVICE_DT_GET(LED_NODE);

    if (!device_is_ready(led_dev)) {
        printk("LED device not ready\n");
        return -1;
    }

    printk("[demo4] 可空 ops 演示·调没实现的动作看返回 -ENOSYS\n");

    /* 1) blink·led_gpio 子类没实现·应当返回 -ENOSYS (-88) */
    int ret = led_blink(led_dev, 0, 500, 500);
    printk("[demo4] led_blink returned %d  (期望 -%d 即 -ENOSYS)\n", ret, ENOSYS);

    /* 2) set_brightness·子类有实现·应当返回 0 */
    ret = led_set_brightness(led_dev, 0, 100);
    printk("[demo4] led_set_brightness returned %d  (期望 0)\n", ret);

    /* 3) on/off·子类有实现·应当返回 0 */
    ret = led_on(led_dev, 0);
    printk("[demo4] led_on returned %d  (期望 0)\n", ret);

    return 0;
}
```
